## boards/shields/Leighboard2026/Kconfig.defconfig
```kconfig
# Copyright (c) 2022 The ZMK Contributors
# SPDX-License-Identifier: MIT

if SHIELD_LEIGHBOARD2026_LEFT

config ZMK_KEYBOARD_NAME
	default "Leighboard2026"

config ZMK_SPLIT_BLE_ROLE_CENTRAL
	default y

endif

if SHIELD_LEIGHBOARD2026_LEFT || SHIELD_LEIGHBOARD2026_RIGHT

config ZMK_SPLIT
	default y

endif
```

## boards/shields/rae_dux/Kconfig.shield
```kconfig
# Copyright (c) 2022 The ZMK Contributors
# SPDX-License-Identifier: MIT

config SHIELD_LEIGHBOARD2026_LEFT
	def_bool $(shields_list_contains,Leighboard2026_left)

config SHIELD_LEIGHBOARD2026_RIGHT
	def_bool $(shields_list_contains,Leighboard2026_right)
```

## boards/shields/sweep/Kconfig.defconfig
```kconfig
# Copyright (c) 2020 The ZMK Contributors
# SPDX-License-Identifier: MIT

if SHIELD_SWEEP_CENTRAL_DONGLE

config ZMK_KEYBOARD_NAME
    default "Sweep"

config ZMK_SPLIT_ROLE_CENTRAL
    default y

config ZMK_SPLIT_BLE_CENTRAL_PERIPHERALS
    default 2

endif

config ZMK_SPLIT
    default y
```

## boards/shields/sweep/Kconfig.shield
```kconfig
config SHIELD_SWEEP_CENTRAL_DONGLE
	def_bool $(shields_list_contains,sweep_central_dongle)

config SHIELD_SWEEP_PERIPHERAL_LEFT
    def_bool $(shields_list_contains,sweep_peripheral_left)

config SHIELD_SWEEP_PERIPHERAL_RIGHT
    def_bool $(shields_list_contains,sweep_peripheral_right)
```
